`default_nettype none
/*
  Output filter of the audio path, between audio_mixer and the I2S DAC.

  The mix is taken at 875 kHz (28 MHz / 32) and decimated x8 to 109.375 kHz, the DAC frame rate, by a
  64-tap FIR: flat up to 20 kHz, -79 dB above 89.4 kHz. All sources simply hold their last value at
  their own rate and share this one filter, so none of them needs a sample rate converter.

  The second pair of channels (in2, out2) goes through the same filter: General Sound and MP3 are kept
  apart from the mix here, for their own filter in audio_img_lpf.v.

  One output period is 256 clocks, 64 per channel, in the order left, left2, right, right2, one MAC per
  clock on a single DSP48A1. The delay line is a 128-word ring per channel, so the 8 samples written
  during a period stay clear of the 64-word window being read.

  Coefficients are generated by audio_fir_gen.py.
*/

module audio_fir_decim (
    input wire clk,                     // 28 MHz
    input wire signed [15:0] in_l,
    input wire signed [15:0] in_r,
    input wire signed [15:0] in2_l,
    input wire signed [15:0] in2_r,
    output reg signed [15:0] out_l = 0,
    output reg signed [15:0] out_r = 0,
    output reg signed [15:0] out2_l = 0,
    output reg signed [15:0] out2_r = 0
);

    reg [7:0] cnt = 0;
    reg [6:0] wp = 0;                   // the sample being written
    reg [6:0] base = 0;                 // the newest sample of this output period

    wire [5:0] tap = cnt[5:0];
    wire [1:0] ch = cnt[7:6];
    wire [8:0] raddr = {ch, base - {1'b0, tap}};
    wire [4:0] coef_idx = tap[5] ? ~tap[4:0] : tap[4:0];

    (* RAM_STYLE = "block" *) reg [15:0] ram [0:511];
    reg signed [15:0] ram_q = 0;

    always @(posedge clk) begin
        cnt <= cnt + 1'b1;

        // one channel in each of the last four clocks of every 32
        if (cnt[4:2] == 3'b111)
            ram[{cnt[1:0], wp}] <= (cnt[1:0] == 2'd0) ? in_l : (cnt[1:0] == 2'd1) ? in2_l :
                                   (cnt[1:0] == 2'd2) ? in_r : in2_r;
        if (cnt[4:0] == 5'd31)
            wp <= wp + 1'b1;
        if (cnt == 8'd255)
            base <= wp;

        ram_q <= ram[raddr];
    end

    reg signed [17:0] coef = 0;         // Q19, the symmetric half of the filter
    always @(posedge clk) begin
        case (coef_idx)
            5'd0 : coef <= -3;
            5'd1 : coef <= -18;
            5'd2 : coef <= -50;
            5'd3 : coef <= -100;
            5'd4 : coef <= -156;
            5'd5 : coef <= -196;
            5'd6 : coef <= -188;
            5'd7 : coef <= -92;
            5'd8 : coef <= 124;
            5'd9 : coef <= 470;
            5'd10: coef <= 917;
            5'd11: coef <= 1390;
            5'd12: coef <= 1763;
            5'd13: coef <= 1872;
            5'd14: coef <= 1552;
            5'd15: coef <= 670;
            5'd16: coef <= -816;
            5'd17: coef <= -2816;
            5'd18: coef <= -5076;
            5'd19: coef <= -7181;
            5'd20: coef <= -8587;
            5'd21: coef <= -8693;
            5'd22: coef <= -6938;
            5'd23: coef <= -2918;
            5'd24: coef <= 3515;
            5'd25: coef <= 12180;
            5'd26: coef <= 22538;
            5'd27: coef <= 33732;
            5'd28: coef <= 44683;
            5'd29: coef <= 54227;
            5'd30: coef <= 61291;
            5'd31: coef <= 65048;
        endcase
    end

    // ram_q/coef -> operands -> product -> accumulator. The channels follow each other without a gap, so
    // the first product of a channel replaces the accumulator and the end of a channel is tracked along
    reg signed [15:0] sample_r = 0;
    reg signed [17:0] coef_r = 0;
    reg signed [33:0] mul = 0;
    reg signed [39:0] acc = 0;
    reg [2:0] first = 0;
    reg [3:0] last = 0;
    reg [1:0] ch1 = 0, ch2 = 0, ch3 = 0, ch4 = 0;

    always @(posedge clk) begin
        sample_r <= ram_q;
        coef_r <= coef;
        mul <= sample_r * coef_r;
        first <= {first[1:0], tap == 6'd0};
        last <= {last[2:0], tap == 6'd63};
        ch1 <= ch;
        ch2 <= ch1;
        ch3 <= ch2;
        ch4 <= ch3;

        if (first[2])
            acc <= mul;
        else
            acc <= acc + mul;
    end

    // the filter overshoots on a full scale square wave, so the result has to be clipped
    wire fits = (acc[39:34] == 6'h00) | (acc[39:34] == 6'h3F);
    wire signed [15:0] result = fits ? acc[34:19] : (acc[39] ? 16'sh8000 : 16'sh7FFF);

    reg signed [15:0] hold_l = 0, hold_l2 = 0, hold_r = 0;

    // all the outputs change together, after the last channel of the period
    always @(posedge clk) begin
        if (last[3]) begin
            case (ch4)
                2'd0: hold_l <= result;
                2'd1: hold_l2 <= result;
                2'd2: hold_r <= result;
                2'd3: begin
                    out_l <= hold_l;
                    out2_l <= hold_l2;
                    out_r <= hold_r;
                    out2_r <= result;
                end
            endcase
        end
    end

endmodule
