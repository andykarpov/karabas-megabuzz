`default_nettype none
/*
  Second filter of the audio path of General Sound and MP3, at the DAC rate of 109.375 kHz: flat up to
  18 kHz, -60 dB above 24.4 kHz. These two sources hold their samples at 37.5 and 44.1 kHz, and the images of
  those rates would otherwise reach the DAC. One output period is 256 clocks: the left channel takes clocks
  0..63, the right one 128..191, one MAC per clock on a single DSP48A1.

  Coefficients are generated by audio_img_gen.py.
*/

module audio_img_lpf (
    input wire clk,                     // 28 MHz
    input wire signed [15:0] in_l,      // both change once per 256 clocks
    input wire signed [15:0] in_r,
    output reg signed [15:0] out_l = 0,
    output reg signed [15:0] out_r = 0
);

    reg [7:0] cnt = 0;
    reg [5:0] wp = 0;
    reg [5:0] base = 0;                 // the newest sample

    wire [5:0] tap = cnt[5:0];
    wire active = ~cnt[6];
    wire [6:0] raddr = {cnt[7], base - tap};
    wire [4:0] coef_idx = tap[5] ? ~tap[4:0] : tap[4:0];

    (* RAM_STYLE = "block" *) reg [15:0] ram [0:127];
    reg signed [15:0] ram_q = 0;

    always @(posedge clk) begin
        cnt <= cnt + 1'b1;

        // clear of the reads of both channels; one write port, or XST builds the RAM out of flip-flops
        if (cnt[7:1] == 7'b1111000)
            ram[{cnt[0], wp}] <= cnt[0] ? in_r : in_l;
        if (cnt == 8'd241)
            wp <= wp + 1'b1;
        if (cnt == 8'd255)
            base <= wp - 1'b1;

        ram_q <= ram[raddr];
    end

    reg signed [17:0] coef = 0;         // Q18, the symmetric half of the filter
    always @(posedge clk) begin
        case (coef_idx)
            5'd0 : coef <= 16;
            5'd1 : coef <= -69;
            5'd2 : coef <= -112;
            5'd3 : coef <= 32;
            5'd4 : coef <= 245;
            5'd5 : coef <= 173;
            5'd6 : coef <= -258;
            5'd7 : coef <= -514;
            5'd8 : coef <= -50;
            5'd9 : coef <= 746;
            5'd10: coef <= 723;
            5'd11: coef <= -474;
            5'd12: coef <= -1447;
            5'd13: coef <= -552;
            5'd14: coef <= 1564;
            5'd15: coef <= 2075;
            5'd16: coef <= -419;
            5'd17: coef <= -3178;
            5'd18: coef <= -2067;
            5'd19: coef <= 2583;
            5'd20: coef <= 4927;
            5'd21: coef <= 596;
            5'd22: coef <= -6191;
            5'd23: coef <= -5991;
            5'd24: coef <= 3536;
            5'd25: coef <= 11501;
            5'd26: coef <= 4835;
            5'd27: coef <= -13274;
            5'd28: coef <= -20383;
            5'd29: coef <= 4117;
            5'd30: coef <= 53751;
            5'd31: coef <= 94631;
        endcase
    end

    // ram_q/coef -> operands -> product -> accumulator
    reg signed [15:0] sample_r = 0;
    reg signed [17:0] coef_r = 0;
    reg signed [33:0] mul = 0;
    reg signed [39:0] acc = 0;
    reg [2:0] act = 0;

    always @(posedge clk) begin
        sample_r <= ram_q;
        coef_r <= coef;
        mul <= sample_r * coef_r;
        act <= {act[1:0], active};

        if (cnt[6:0] == 7'd70)
            acc <= 0;
        else if (act[2])
            acc <= acc + mul;
    end

    wire fits = (acc[39:33] == 7'h00) | (acc[39:33] == 7'h7F);
    wire signed [15:0] result = fits ? acc[33:18] : (acc[39] ? 16'sh8000 : 16'sh7FFF);

    reg signed [15:0] hold_l = 0;

    // the last product reaches acc at clock 67 of the channel; both outputs change together
    always @(posedge clk) begin
        if (cnt == 8'd68)
            hold_l <= result;
        if (cnt == 8'd196) begin
            out_l <= hold_l;
            out_r <= result;
        end
    end

endmodule
